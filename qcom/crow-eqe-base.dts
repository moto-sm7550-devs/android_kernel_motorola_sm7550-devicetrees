/* Copyright (c) 2023, The Linux Foundation. All rights reserved.
 *
 * This program is free software; you can redistribute it and/or modify
 * it under the terms of the GNU General Public License version 2 and
 * only version 2 as published by the Free Software Foundation.
 *
 * This program is distributed in the hope that it will be useful,
 * but WITHOUT ANY WARRANTY; without even the implied warranty of
 * MERCHANTABILITY or FITNESS FOR A PARTICULAR PURPOSE.  See the
 * GNU General Public License for more details.
 */

/dts-v1/;

#include "crow-moto-common-base.dtsi"

&aliases {
	i2c0 = &qupv3_se1_i2c;
	i2c1 = &qupv3_se8_i2c;
	i2c2 = &qupv3_se13_i2c;
	i2c3 = &qupv3_se15_i2c;
};

