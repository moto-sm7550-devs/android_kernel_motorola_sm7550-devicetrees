
/* This is derivated from qcom crow-sde-display-mtp-overlay.dts */

/dts-v1/;
/plugin/;

#include "crow-sde-display-eqe-common.dtsi"
#define EQE_RADIO_JP 3
/ {
	model = "eqe";
	compatible = "qcom,crow-idp", "qcom,crow", "qcom,idp", "mot,eqe";
	qcom,msm-id = <608 0x10000>;
	qcom,board-id = <0x41 0xB100>,<(EQE_RADIO_JP << 8 | 0x41) 0xB100>;

};
