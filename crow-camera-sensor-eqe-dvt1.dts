
/* this is derivated from qcom kalama-camera-sensor-mtp.dts */

/dts-v1/;
/plugin/;

#include <dt-bindings/clock/qcom,gcc-crow.h>
#include <dt-bindings/clock/qcom,camcc-crow.h>
#include <dt-bindings/interconnect/qcom,crow.h>
#include <dt-bindings/interrupt-controller/arm-gic.h>
#include <dt-bindings/regulator/qcom,rpmh-regulator-levels.h>

#include "crow-camera-sensor-eqe-dvt1.dtsi"
#define EQE_RADIO_JP 3
/ {
        model = "eqe";
        compatible = "qcom,crow-idp", "qcom,crow", "qcom,idp", "qcom,eqe";
        qcom,msm-id = <608 0x10000>;
        qcom,board-id = <0x41 0xB100>,<(EQE_RADIO_JP << 8 | 0x41) 0xB100>;
};
